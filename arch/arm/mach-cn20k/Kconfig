## arch/arm/mach-cn20k/Kconfig
```kconfig
if ARCH_CN20K

choice
	prompt "CN20K board select"
	optional

config TARGET_CN20K_A
	bool "Marvell CN20KA SoC"
	help
	  The MRVL CN20K is a ARM64-based SoC.
	  It is based ARMv9 architecture.

config TARGET_CNF20K_A
	bool "Marvell CNF20KA Fusion SoC"
	help
	  The MRVL CNF20K is a ARM64-based SoC.
	  It is based ARMv9 architecture.

endchoice

config SYS_SOC
	string
	default "cn20k"

config SYS_PCI_64BIT
	bool
	default y

endif
```

## arch/arm/mach-thunderx/Kconfig
```kconfig
if ARCH_THUNDERX

config SYS_VENDOR
	string
	default	"cavium"

config SYS_SOC
	string
	default "thunderx"

config SYS_BOARD
	string
	default "thunderx"

config SYS_PCI_64BIT
	bool
	default y

endif
```

## board/Marvell/cn10k/Kconfig
```kconfig
if TARGET_CN10K_A || TARGET_CN10K_B || TARGET_CNF10K_A || TARGET_CNF10K_B

config SYS_VENDOR
	string
	default	"Marvell"

config SYS_BOARD
	string
	default "cn10k"

config SYS_CONFIG_NAME
	default "cn10k_common"

endif

if TARGET_CN10K_A

config CN10K_FIXED_MGMT_PORT
	bool "Fixed Management port as first interface"
	default n
	help
	  Always set up first ethernet interface to be fixed port
	  defined in privileged firmware components.

config CN10K_MAP_RESERVE
	bool "Enable reserved region mapping"
	default n
	help
	  Enable mapping of reserved regions to MMU for access
	  from U-Boot.

endif
```

## board/Marvell/cn20k/Kconfig
```kconfig
if TARGET_CN20K_A || TARGET_CNF20K_A

config SYS_VENDOR
	string
	default	"Marvell"

config SYS_BOARD
	string
	default "cn20k"

config SYS_CONFIG_NAME
	default "cn20k_common"

config CN20K_MAP_RESERVE
	bool "Enable reserved region mapping"
	default n
	help
	  Enable mapping of reserved regions to MMU for access
	  from U-Boot.
endif
```

## board/Marvell/octeontx2/Kconfig
```kconfig
if TARGET_OCTEONTX2_95XX || TARGET_OCTEONTX2_96XX || TARGET_OCTEONTX2_LOKI

config SYS_VENDOR
	string
	default	"Marvell"

config SYS_BOARD
	string
	default "octeontx2"

config SYS_CONFIG_NAME
	default "octeontx2_96xx" if TARGET_OCTEONTX2_96XX
	default "octeontx2_95xx" if TARGET_OCTEONTX2_95XX
	default "octeontx2_loki" if TARGET_OCTEONTX2_LOKI

endif
```

## board/cavium/octeontx/Kconfig
```kconfig
choice
	prompt "Target board"

config	TARGET_OCTEONTX_83XX
	bool "OcteonTX CN83XX"

config	TARGET_OCTEONTX_81XX
	bool "OcteonTX CN81XX"

config	TARGET_OCTEONTX_93XX
	bool "OcteonTX CN93XX"

endchoice

config SYS_CONFIG_NAME
	default "octeontx_81xx" if TARGET_OCTEONTX_81XX
	default "octeontx_83xx" if TARGET_OCTEONTX_83XX
	default "octeontx_93xx" if TARGET_OCTEONTX_93XX
```

## board/cavium/octeontx2/Kconfig
```kconfig
choice
	prompt "Target board"

config	TARGET_OCTEONTX2_93XX
	bool "OcteonTX CN93XX"

endchoice

config SYS_CONFIG_NAME
	default "octeontx2_93xx" if TARGET_OCTEONTX2_93XX
```

## board/cavium/thunderx/Kconfig
```kconfig
choice
	prompt "Target board"

config	TARGET_THUNDERX_83XX
	bool "ThunderX CN83XX"

config	TARGET_THUNDERX_81XX
	bool "ThunderX CN81XX"

config	TARGET_THUNDERX_93XX
	bool "ThunderX CN93XX"

endchoice

config SYS_CONFIG_NAME
	default "thunderx_81xx" if TARGET_THUNDERX_81XX
	default "thunderx_83xx" if TARGET_THUNDERX_83XX
	default "thunderx_93xx" if TARGET_THUNDERX_93XX
```

## board/solidrun/imx8mm_som/Kconfig
```kconfig
config TARGET_IMX8MM_SR_SOM
	bool "SolidRun i.MX8MM SoM"
	select IMX8MM
	select SUPPORT_SPL
	select IMX8M_LPDDR4
	select FSL_CAAM
	select FSL_BLOB
	select ARCH_MISC_INIT
	select SPL_CRYPTO if SPL

if TARGET_IMX8MM_SR_SOM

config SYS_BOARD
	default "imx8mm_som"

config SYS_VENDOR
	default "solidrun"

config SYS_CONFIG_NAME
	default "imx8mm_som"

config IMX_CONFIG
	default "board/freescale/imx8mm_evk/imximage-8mm.cfg"

endif
```

## board/solidrun/imx8mp_solidrun/Kconfig
```kconfig
if TARGET_IMX8MP_SOLIDRUN

config SYS_BOARD
	default "imx8mp_solidrun"

config SYS_VENDOR
	default "solidrun"

config SYS_CONFIG_NAME
	default "imx8mp_solidrun"

config IMX_CONFIG
	default "board/solidrun/imx8mp_solidrun/imximage-8mp-sd.cfg"

endif
```

## board/solidrun/rzg-common/Kconfig
```kconfig
config RZG_SOLIDRUN_COMMON
    bool "Common configuration for RZG2L_SOLIDRUN targets"
    depends on TARGET_RZG2L_SOLIDRUN || TARGET_RZG2LC_SOLIDRUN || TARGET_RZG2UL_SOLIDRUN || TARGET_RZV2L_SOLIDRUN || TARGET_RZV2N_SOLIDRUN
    default y
    select NET
    select DM_ETH
    select RENESAS_RAVB
    select BITBANGMII
    select USB
    select DM_USB
    select USB_GADGET
    select USB_RENESAS_USBHS
    select USB_EHCI_HCD
    select USB_EHCI_GENERIC
    select PHY_RCAR_GEN3
    select DM_I2C
    select SYS_I2C_RZG2L_RIIC
    select I2C_EEPROM
    select CMD_TLV_EEPROM
    select DM_GPIO
    select GPIO_HOG
    select PINCTRL_PFC_RZG2L if !TARGET_RZV2N_SOLIDRUN
    select RZG2L_GPIO if !TARGET_RZV2N_SOLIDRUN
    select CLK
    select CLK_RENESAS
    select CLK_R9A07G044L if !TARGET_RZV2N_SOLIDRUN
    select CLK_R9A07G054L if !TARGET_RZV2N_SOLIDRUN
    select CLK_R9A09G056 if TARGET_RZV2N_SOLIDRUN
    select DM_REGULATOR
    select WATCHDOG if !TARGET_RZV2N_SOLIDRUN
    select SYSRESET if !TARGET_RZV2N_SOLIDRUN
    select SYSRESET_WATCHDOG if !TARGET_RZV2N_SOLIDRUN
    select RENESAS_RZG2LWDT if !TARGET_RZV2N_SOLIDRUN
    select MISC
    select SCIF_CONSOLE
    select SH_SDHI
    select OF_CONTROL
    select OF_PLATDATA
    select OF_LIBFDT_OVERLAY
    select BOARD_EARLY_INIT_R
    select BOARD_LATE_INIT
    select CMD_READ

    help
      This option enables common board support code for RZG2L/RZG2LC/RZV2N solidrun SOMs.

config SOLIDRUN_DISABLE_TLV
    bool "Do not use tlv eeprom for dts selection and vbus output type choice"
	depends on RZG_SOLIDRUN_COMMON
    default n
    help
      Do not use tlv eeprom for dts selection and vbus output type choice.

config SOLIDRUN_FORCE_SD_BOOT
    bool "Force the SD/eMMC selection to always use SD"
	depends on RZG_SOLIDRUN_COMMON
    default n
    help
      Force the SD/eMMC selection to always use SD.

config SOLIDRUN_FORCE_MMC_BOOT
    bool "Force the SD/eMMC selection to always use eMMC"
	depends on RZG_SOLIDRUN_COMMON && !SOLIDRUN_FORCE_SD_BOOT
    default n
    help
      Force the SD/eMMC selection to always use SD.
```

## board/solidrun/rzg2l/Kconfig
```kconfig
if TARGET_RZG2L_SOLIDRUN

config SYS_SOC
	default "rmobile"

config SYS_BOARD
	default "rzg2l"

config SYS_VENDOR
	default "solidrun"

config SYS_CONFIG_NAME
	default "rzg2l-solidrun"

endif
```

## board/solidrun/rzg2lc/Kconfig
```kconfig
if TARGET_RZG2LC_HUMMINGBOARD

config SYS_SOC
	default "rmobile"

config SYS_BOARD
	default "rzg2lc-hummingboard"

config SYS_VENDOR
	default "solidrun"

config SYS_CONFIG_NAME
	default "rzg2lc-hummingboard"

endif
```

## board/solidrun/rzg2ul/Kconfig
```kconfig
if TARGET_RZG2UL_SOLIDRUN

config SYS_SOC
	default "rmobile"

config SYS_BOARD
	default "rzg2ul"

config SYS_VENDOR
	default "solidrun"

config SYS_CONFIG_NAME
	default "rzg2ul-solidrun"

endif
```

## board/solidrun/rzv2l/Kconfig
```kconfig
if TARGET_RZV2L_SOLIDRUN

config SYS_SOC
        default "rmobile"

config SYS_BOARD
        default "rzv2l"

config SYS_VENDOR
        default "solidrun"

config SYS_CONFIG_NAME
        default "rzv2l-solidrun"

endif
```

## board/solidrun/rzv2n/Kconfig
```kconfig
if TARGET_RZV2N_SOLIDRUN

config SYS_SOC
        default "renesas"

config SYS_BOARD
        default "rzv2n"

config SYS_VENDOR
        default "solidrun"

config SYS_CONFIG_NAME
        default "rzv2n-solidrun"

endif
```

## board/solidrun/solidsense-n8/Kconfig
```kconfig
if TARGET_SOLIDSENSE_N8

config SYS_BOARD
	default "solidsense-n8"

config SYS_VENDOR
	default "solidrun"

config SYS_CONFIG_NAME
	default "imx8mn_evk"

config IMX8MN_LOW_DRIVE_MODE
	bool "Enable the low drive mode of iMX8MN on SolidSense N8"

config IMX_CONFIG
	default "board/freescale/imx8mn_evk/imximage-8mn-ddr4.cfg"

endif
```

## cmd/mvebu/Kconfig
```kconfig
menu "MVEBU commands"
depends on ARCH_MVEBU

config CMD_MVEBU_BUBT
	bool "bubt"
	select SHA256 if ARMADA_3700
	select SHA512 if ARMADA_3700
	select MVEBU_EFUSE if ARMADA_38X || ARMADA_3700
	help
	  bubt - Burn a u-boot image to flash
	  For details about bubt command please see the documentation
	  in doc/mvebu/cmd/bubt.txt

if CMD_MVEBU_BUBT

config CMD_MVEBU_HW_INFO
	bool "hw_info"
	select BOARD_CONFIG_EEPROM
	default n
	help
	  hw_info - load HW information such as board ID, PCB SLM number,
	  MAC addresses from EEPROM and apply them to environment variables.
	  And update the MAC address in FDT file for Linux.
	  When save the box information, it will be saved to EEPROM.

choice
	prompt "Flash for image"
	default MVEBU_SPI_BOOT

config MVEBU_NAND_BOOT
	bool "NAND flash boot"
	depends on NAND_PXA3XX
	help
	  Enable boot from NAND flash.
	  Allow usage of NAND flash as a target for "bubt" command
	  For details about bubt command please see the documentation
	  in doc/mvebu/cmd/bubt.txt

config MVEBU_SPI_BOOT
	bool "SPI flash boot"
	depends on SPI_FLASH
	help
	  Enable boot from SPI flash.
	  Allow usage of SPI flash as a target for "bubt" command
	  For details about bubt command please see the documentation
	  in doc/mvebu/cmd/bubt.txt

config MVEBU_MMC_BOOT
	bool "eMMC flash boot"
	depends on MVEBU_MMC || MMC_SDHCI_XENON
	help
	  Enable boot from eMMC boot partition
	  Allow usage of eMMC/SD device as a target for "bubt" command
	  For details about bubt command please see the documentation
	  in doc/mvebu/cmd/bubt.txt

endchoice

config MVEBU_UBOOT_DFLT_NAME
	string "Default image name for bubt command"
	default "flash-image.bin"
	help
	  This option should contain a default file name to be used with
	  MVEBU "bubt" command if the source file name is omitted

endif

config CMD_MVEBU_COMPHY_RX_TRAINING
	bool "mvebu_comphy_rx_training"
	depends on ARMADA_8K
	help
	  Perform COMPHY RX training sequence

endmenu
```

## configs/cnf10kb_defconfig
```kconfig
CONFIG_ARM=y
# CONFIG_ARM64_SUPPORT_AARCH32 is not set
CONFIG_ARCH_CN10K=y
CONFIG_TEXT_BASE=0x4000000
CONFIG_SYS_MALLOC_LEN=0x8000000
CONFIG_SYS_MALLOC_F_LEN=0x4000
CONFIG_NR_DRAM_BANKS=1
CONFIG_ENV_SIZE=0x10000
CONFIG_ENV_OFFSET=0xE20000
CONFIG_ENV_SECT_SIZE=0x10000
CONFIG_TARGET_CNF10K_B=y
CONFIG_DM_GPIO=y
CONFIG_SYS_PROMPT="Marvell> "
CONFIG_DEBUG_UART_BASE=0x87e028000000
CONFIG_DEBUG_UART_CLOCK=24000000
CONFIG_ARMV8_SUPPORT_V3_EXTENSION=y
CONFIG_SYS_LOAD_ADDR=0x5000000
CONFIG_DEBUG_UART=y
CONFIG_HAS_CUSTOM_SYS_INIT_SP_ADDR=y
CONFIG_CUSTOM_SYS_INIT_SP_ADDR=0x4fffff0
# CONFIG_SYS_MALLOC_CLEAR_ON_INIT is not set
CONFIG_FIT=y
CONFIG_FIT_SIGNATURE=y
CONFIG_OF_BOARD_SETUP=y
CONFIG_BOOTDELAY=5
CONFIG_BOOT_RETRY=y
CONFIG_BOOT_RETRY_TIME=-1
CONFIG_BOOT_RETRY_MIN=30
CONFIG_RESET_TO_RETRY=y
CONFIG_USE_BOOTARGS=y
CONFIG_BOOTARGS="console=ttyAMA0,115200n8 earlycon=pl011,0x87e028000000 maxcpus=12 rootwait rw root=/dev/mmcblk0p2"
# CONFIG_DISPLAY_CPUINFO is not set
CONFIG_BOARD_EARLY_INIT_R=y
CONFIG_LAST_STAGE_INIT=y
CONFIG_HUSH_PARSER=y
CONFIG_SYS_MAXARGS=64
CONFIG_SYS_BOOTM_LEN=0x10000000
# CONFIG_CMD_BOOTEFI_HELLO_COMPILE is not set
CONFIG_CMD_MD5SUM=y
CONFIG_MD5SUM_VERIFY=y
CONFIG_CMD_MX_CYCLIC=y
CONFIG_CMD_MEMTEST=y
CONFIG_CMD_SHA1SUM=y
CONFIG_SHA1SUM_VERIFY=y
CONFIG_CMD_DM=y
# CONFIG_CMD_FLASH is not set
CONFIG_CMD_GPIO=y
CONFIG_CMD_I2C=y
CONFIG_CMD_MMC=y
CONFIG_CMD_PART=y
CONFIG_CMD_PCI=y
CONFIG_CMD_SF_TEST=y
CONFIG_CMD_DHCP=y
CONFIG_BOOTP_BOOTFILESIZE=y
CONFIG_CMD_PING=y
CONFIG_CMD_LINK_LOCAL=y
CONFIG_CMD_TIME=y
CONFIG_CMD_FAILSAFE=y
CONFIG_CMD_ETH=y
CONFIG_CMD_SERDES_DIAGNOSTICS=y
CONFIG_CMD_PHY_DIAGNOSTICS=y
CONFIG_CMD_BOOTIMGUP_CN10K=y
CONFIG_CMD_TPM=y
CONFIG_CMD_TPM_TEST=y
CONFIG_CMD_EXT2=y
CONFIG_CMD_EXT4=y
CONFIG_CMD_EXT4_WRITE=y
CONFIG_CMD_FAT=y
CONFIG_CMD_FS_GENERIC=y
CONFIG_EFI_PARTITION=y
CONFIG_PARTITION_TYPE_GUID=y
CONFIG_ENV_OVERWRITE=y
CONFIG_ENV_IS_IN_SPI_FLASH=y
CONFIG_VERSION_VARIABLE=y
CONFIG_NET_RANDOM_ETHADDR=y
CONFIG_IP_DEFRAG=y
CONFIG_TFTP_TSIZE=y
CONFIG_I2C_GPIO=y
CONFIG_DM_I2C=y
CONFIG_I2C_SET_DEFAULT_BUS_NUM=y
CONFIG_I2C_MUX=y
CONFIG_I2C_MUX_PCA954x=y
CONFIG_MISC=y
CONFIG_SYS_MMC_MAX_BLK_COUNT=32768
CONFIG_SUPPORT_EMMC_RPMB=y
CONFIG_SUPPORT_EMMC_BOOT=y
CONFIG_MMC_HS400_ES_SUPPORT=y
CONFIG_MMC_HS400_SUPPORT=y
CONFIG_MMC_SDHCI=y
CONFIG_MTD=y
CONFIG_DM_SPI_FLASH=y
CONFIG_SF_DEFAULT_SPEED=125000000
CONFIG_SPI_FLASH_SFDP_SUPPORT=y
CONFIG_SPI_FLASH_MACRONIX=y
CONFIG_SPI_FLASH_SPANSION=y
CONFIG_SPI_FLASH_STMICRO=y
CONFIG_SPI_FLASH_WINBOND=y
CONFIG_E1000=y
CONFIG_E1000_SPI=y
CONFIG_CMD_E1000=y
CONFIG_NET_CN10K=y
CONFIG_NET_CN10K_DPI=y
CONFIG_NVME_PCI=y
CONFIG_PCI=y
CONFIG_DM_PCI_COMPAT=y
CONFIG_PCI_REGION_MULTI_ENTRY=y
CONFIG_PCI_SRIOV=y
CONFIG_PCI_ARID=y
CONFIG_PCI_OCTEONTX=y
CONFIG_DM_REGULATOR=y
CONFIG_DM_REGULATOR_FIXED=y
CONFIG_DM_REGULATOR_GPIO=y
# CONFIG_DM_RNG is not set
CONFIG_DM_RTC=y
CONFIG_RTC_DS1337=y
CONFIG_DM_SERIAL=y
CONFIG_DEBUG_UART_SKIP_INIT=y
CONFIG_PL01X_SERIAL=y
CONFIG_OCTEONTX_SERIAL_BOOTCMD=y
CONFIG_OCTEONTX_SERIAL_PCIE_CONSOLE=y
CONFIG_SPI=y
CONFIG_DM_SPI=y
CONFIG_CADENCE_XSPI=y
CONFIG_TPM2_TIS_SPI=y
CONFIG_TPM2_TIS_I2C=y
CONFIG_WDT=y
CONFIG_TPM=y
CONFIG_ERRNO_STR=y
```
