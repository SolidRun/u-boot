## configs/cnf20ka_defconfig
```kconfig
CONFIG_ARM=y
# CONFIG_ARM64_SUPPORT_AARCH32 is not set
CONFIG_ARCH_CN20K=y
CONFIG_TEXT_BASE=0x4000000
CONFIG_SYS_MALLOC_LEN=0x4000000
CONFIG_SYS_MALLOC_F_LEN=0x4000
CONFIG_NR_DRAM_BANKS=1
CONFIG_ENV_SIZE=0x10000
CONFIG_ENV_OFFSET=0x1E20000
CONFIG_ENV_SECT_SIZE=0x10000
CONFIG_TARGET_CNF20K_A=y
CONFIG_DM_GPIO=y
CONFIG_SYS_PROMPT="Marvell> "
CONFIG_DEBUG_UART_BASE=0xc02000000000
CONFIG_DEBUG_UART_CLOCK=24000000
CONFIG_ARMV8_SUPPORT_V3_EXTENSION=y
CONFIG_SYS_LOAD_ADDR=0x5000000
CONFIG_DEBUG_UART=y
CONFIG_HAS_CUSTOM_SYS_INIT_SP_ADDR=y
CONFIG_CUSTOM_SYS_INIT_SP_ADDR=0x4fffff0
# CONFIG_SYS_MALLOC_CLEAR_ON_INIT is not set
CONFIG_FIT=y
CONFIG_TIMESTAMP=y
CONFIG_FIT_SIGNATURE=y
CONFIG_SUPPORT_RAW_INITRD=y
CONFIG_OF_BOARD_SETUP=y
CONFIG_BOOTDELAY=5
CONFIG_BOOT_RETRY=y
CONFIG_BOOT_RETRY_TIME=-1
CONFIG_BOOT_RETRY_MIN=30
CONFIG_RESET_TO_RETRY=y
CONFIG_USE_BOOTARGS=y
CONFIG_BOOTARGS="console=ttyAMA0,115200n8 earlycon=pl011,0xc02000000000 maxcpus=16 rootwait rw root=/dev/mmcblk0p2"
CONFIG_CONSOLE_MUX=y
CONFIG_SYS_STDIO_DEREGISTER=y
# CONFIG_DISPLAY_CPUINFO is not set
CONFIG_BOARD_EARLY_INIT_R=y
CONFIG_LAST_STAGE_INIT=y
CONFIG_HUSH_PARSER=y
CONFIG_SYS_MAXARGS=64
CONFIG_SYS_BOOTM_LEN=0x10000000
# CONFIG_CMD_BOOTEFI_HELLO is not set
CONFIG_CMD_BOOTEFI_SELFTEST=y
CONFIG_CMD_NVEDIT_EFI=y
CONFIG_CMD_MD5SUM=y
CONFIG_MD5SUM_VERIFY=y
CONFIG_CMD_MX_CYCLIC=y
CONFIG_CMD_MEMTEST=y
CONFIG_CMD_SHA1SUM=y
CONFIG_SHA1SUM_VERIFY=y
CONFIG_CMD_DM=y
CONFIG_CMD_GPIO=y
CONFIG_CMD_GPIO_READ=y
CONFIG_CMD_I2C=y
CONFIG_CMD_MMC=y
CONFIG_CMD_PART=y
CONFIG_CMD_PCI=y
# CONFIG_CMD_POWEROFF is not set
CONFIG_CMD_EFIDEBUG=y
CONFIG_CMD_EFICONFIG=y
CONFIG_CMD_FAILSAFE=y
CONFIG_CMD_EXT2=y
CONFIG_CMD_EXT4=y
CONFIG_CMD_EXT4_WRITE=y
CONFIG_CMD_FAT=y
CONFIG_CMD_FS_GENERIC=y
CONFIG_EFI_PARTITION=y
CONFIG_PARTITION_TYPE_GUID=y
CONFIG_ENV_OVERWRITE=y
CONFIG_ENV_IS_IN_SPI_FLASH=y
CONFIG_VERSION_VARIABLE=y
CONFIG_EFI_MEDIA=y
CONFIG_DM_I2C=y
CONFIG_MISC=y
# CONFIG_MMC_HW_PARTITIONING is not set
CONFIG_SUPPORT_EMMC_RPMB=y
CONFIG_SUPPORT_EMMC_BOOT=y
CONFIG_MMC_HS400_ES_SUPPORT=y
CONFIG_MMC_HS400_SUPPORT=y
CONFIG_MMC_SDHCI=y
CONFIG_MMC_SDHCI_CADENCE=y
CONFIG_MTD=y
CONFIG_DM_SPI_FLASH=y
CONFIG_SF_DEFAULT_SPEED=125000000
CONFIG_SPI_FLASH_SFDP_SUPPORT=y
# CONFIG_SPI_FLASH_UNLOCK_ALL is not set
CONFIG_SPI_FLASH_MACRONIX=y
CONFIG_SPI_FLASH_SPANSION=y
CONFIG_SPI_FLASH_STMICRO=y
CONFIG_SPI_FLASH_WINBOND=y
# CONFIG_SPI_FLASH_USE_4K_SECTORS is not set
# CONFIG_NETDEVICES is not set
CONFIG_PCI=y
CONFIG_DM_PCI_COMPAT=y
CONFIG_PCI_REGION_MULTI_ENTRY=y
CONFIG_PCI_SRIOV=y
CONFIG_PCI_ARID=y
CONFIG_PCI_OCTEONTX=y
# CONFIG_POWER is not set
CONFIG_DM_SERIAL=y
CONFIG_DEBUG_UART_SKIP_INIT=y
CONFIG_PL01X_SERIAL=y
CONFIG_SPI=y
CONFIG_DM_SPI=y
CONFIG_CADENCE_XSPI=y
CONFIG_WDT=y
CONFIG_SHA384=y
CONFIG_ERRNO_STR=y
CONFIG_OF_LIBFDT_OVERLAY=y
# CONFIG_GENERATE_SMBIOS_TABLE is not set
CONFIG_EFI_VARIABLE_NO_STORE=y
CONFIG_EFI_SPI_NOR_FLASH_PROTOCOL=y
CONFIG_EFI_PCI_IO_PROTOCOL=y
CONFIG_EFI_GPIO_PROTOCOL=y
CONFIG_EFI_I2C_PROTOCOL=y
```

## configs/octeontx2_95xx_defconfig
```kconfig
CONFIG_ARM=y
# CONFIG_ARM64_SUPPORT_AARCH32 is not set
CONFIG_ARCH_OCTEONTX2=y
CONFIG_SYS_TEXT_BASE=0x04000000
CONFIG_IDENT_STRING=" for Cavium OcteonTX2 CNF95XX ARM V8 Core"
# CONFIG_PSCI_RESET is not set
CONFIG_TARGET_OCTEONTX2_95XX=y
CONFIG_DEBUG_UART=y
# CONFIG_AHCI is not set
CONFIG_FIT=y
CONFIG_FIT_SIGNATURE=y
CONFIG_OF_BOARD_SETUP=y
CONFIG_BOOTDELAY=5
CONFIG_USE_BOOTARGS=y
CONFIG_BOOTARGS="console=ttyAMA0,115200n8 earlycon=pl011,0x87e028000000 debug maxcpus=6 rootwait rw root=/dev/mmcblk0p2 coherent_pool=16M"
CONFIG_VERSION_VARIABLE=y
# CONFIG_DISPLAY_CPUINFO is not set
# CONFIG_DISPLAY_BOARDINFO is not set
CONFIG_BOARD_EARLY_INIT_R=y
CONFIG_HUSH_PARSER=y
CONFIG_SYS_PROMPT="Cavium> "
# CONFIG_CMD_BOOTEFI_HELLO_COMPILE is not set
CONFIG_CMD_MEMTEST=y
CONFIG_CMD_MX_CYCLIC=y
# CONFIG_CMD_FLASH is not set
# CONFIG_CMD_FPGA is not set
CONFIG_CMD_GPIO=y
CONFIG_CMD_I2C=y
CONFIG_CMD_MMC=y
CONFIG_CMD_PART=y
CONFIG_CMD_PCI=y
CONFIG_CMD_SF=y
# CONFIG_CMD_USB is not set
CONFIG_CMD_TFTPPUT=y
CONFIG_CMD_TFTPSRV=y
CONFIG_CMD_RARP=y
CONFIG_CMD_DHCP=y
CONFIG_CMD_PXE=y
CONFIG_CMD_MII=y
CONFIG_CMD_PING=y
CONFIG_CMD_CDP=y
CONFIG_CMD_SNTP=y
CONFIG_CMD_DNS=y
CONFIG_CMD_LINK_LOCAL=y
CONFIG_CMD_BOOTIMGUP=y
CONFIG_CMD_EXT2=y
CONFIG_CMD_EXT4=y
CONFIG_CMD_EXT4_WRITE=y
CONFIG_CMD_FAT=y
CONFIG_CMD_FS_GENERIC=y
CONFIG_EFI_PARTITION=y
CONFIG_PARTITION_TYPE_GUID=y
CONFIG_OF_BOARD=y
CONFIG_ENV_IS_IN_SPI_FLASH=y
CONFIG_NET_RANDOM_ETHADDR=y
# CONFIG_SCSI_AHCI is not set
# CONFIG_AHCI_PCI is not set
CONFIG_BLOCK_CACHE=y
CONFIG_DM_GPIO=y
CONFIG_DM_I2C=y
CONFIG_MISC=y
# CONFIG_MMC is not set
CONFIG_DM_MMC=y
CONFIG_MMC_CAVIUM=y
CONFIG_MTD=y
CONFIG_DM_SPI_FLASH=y
CONFIG_SPI_FLASH=y
CONFIG_SPI_FLASH_4BAIS=y
CONFIG_SPI_FLASH_MACRONIX=y
CONFIG_SPI_FLASH_SPANSION=y
CONFIG_SPI_FLASH_STMICRO=y
CONFIG_SPI_FLASH_WINBOND=y
CONFIG_NETDEVICES=y
CONFIG_CAVIUM_NET_OCTEONTX2=y
CONFIG_OCTEONTX2_CGX=y
CONFIG_PCI=y
CONFIG_DM_PCI=y
CONFIG_DM_PCI_COMPAT=y
CONFIG_PCI_OCTEONTX_ECAM=y
CONFIG_SCSI=y
CONFIG_DM_SCSI=y
CONFIG_DM_SERIAL=y
CONFIG_DEBUG_UART_PL011=y
CONFIG_DEBUG_UART_BASE=0x87e028000000
CONFIG_DEBUG_UART_CLOCK=24000000
CONFIG_DEBUG_UART_SKIP_INIT=y
CONFIG_PL01X_SERIAL=y
CONFIG_DM_SPI=y
CONFIG_CAVIUM_SPI=y
# CONFIG_USB is not set
# CONFIG_DM_USB is not set
# CONFIG_USB_XHCI_HCD is not set
# CONFIG_USB_XHCI_PCI is not set
# CONFIG_USB_STORAGE is not set
CONFIG_FAT_WRITE=y
CONFIG_ERRNO_STR=y
```

## configs/rzg2lc-solidrun_defconfig
```kconfig
CONFIG_ARM=y
CONFIG_ARCH_CPU_INIT=y
CONFIG_ARCH_RMOBILE=y
CONFIG_RCAR_GEN3=y
CONFIG_R9A07G044C=y
CONFIG_TARGET_RZG2LC_SOLIDRUN=y
CONFIG_SYS_TEXT_BASE=0x50000000
CONFIG_ENV_SIZE=0x20000
CONFIG_ENV_OFFSET=0x3c0000
CONFIG_DEFAULT_DEVICE_TREE="rzg2lc-solidrun"
CONFIG_USE_BOOTARGS=y
CONFIG_BOOTARGS="rw rootwait root=/dev/mmcblk0p2"
CONFIG_USE_BOOTCOMMAND=y
CONFIG_DEFAULT_FDT_FILE="renesas/rzg2lc-hummingboard.dtb"
CONFIG_OF_LIST="rzg2lc-solidrun"
CONFIG_ENV_IS_IN_MMC=y
CONFIG_SYS_MMC_ENV_DEV=0
CONFIG_SYS_MMC_ENV_PART=1
CONFIG_MULTI_DTB_FIT_LZO=y
CONFIG_MULTI_DTB_FIT_USER_DEFINED_AREA=y
CONFIG_SPL=n
CONFIG_FIT=y
CONFIG_ENV_OVERWRITE=y
CONFIG_SUPPORT_RAW_INITRD=y
CONFIG_SYS_RELOC_GD_ENV_ADDR=y
CONFIG_TEE=y
CONFIG_OPTEE=y
CONFIG_VERSION_VARIABLE=y
CONFIG_USB_STORAGE=y
CONFIG_NET_RANDOM_ETHADDR=y
CONFIG_PARTITION_UUIDS=y
CONFIG_DISTRO_DEFAULTS=y
CONFIG_CMD_BOOTZ=y
CONFIG_CMD_GPIO=y
CONFIG_CMD_I2C=y
CONFIG_CMD_MMC=y
CONFIG_CMD_USB=y
CONFIG_CMD_DHCP=y
CONFIG_CMD_MII=y
CONFIG_CMD_PING=y
CONFIG_CMD_SYSBOOT=y
CONFIG_CMD_PART=y
CONFIG_CMD_FS_UUID=y
CONFIG_CMD_TLV_EEPROM=y
CONFIG_CMD_ERASEENV=y
CONFIG_LOGLEVEL=7
CONFIG_SUPPORT_EMMC_BOOT=y
```

## configs/rzg2ul-solidrun_defconfig
```kconfig
CONFIG_ARM=y
CONFIG_ARCH_CPU_INIT=y
CONFIG_ARCH_RMOBILE=y
CONFIG_SYS_TEXT_BASE=0x50000000
CONFIG_ENV_SIZE=0x20000
CONFIG_ENV_OFFSET=0x3c0000
CONFIG_DEFAULT_DEVICE_TREE="rzg2ul-solidrun"
CONFIG_RCAR_GEN3=y
CONFIG_R9A07G043U=y
CONFIG_TARGET_RZG2UL_SOLIDRUN=y
# CONFIG_SPL is not set
CONFIG_DISTRO_DEFAULTS=y
CONFIG_FIT=y
CONFIG_USE_BOOTARGS=y
CONFIG_BOOTARGS="rw rootwait root=/dev/mmcblk0p2"
CONFIG_DEFAULT_FDT_FILE="renesas/r9a07g043u12-hummingboard-ripple.dtb"
CONFIG_LOGLEVEL=7
CONFIG_CMD_TLV_EEPROM=y
CONFIG_CMD_BOOTZ=y
CONFIG_CMD_ERASEENV=y
CONFIG_CMD_GPIO=y
CONFIG_CMD_I2C=y
CONFIG_CMD_MMC=y
CONFIG_CMD_USB=y
CONFIG_ENV_OVERWRITE=y
CONFIG_ENV_IS_IN_MMC=y
CONFIG_SYS_RELOC_GD_ENV_ADDR=y
CONFIG_SYS_MMC_ENV_PART=1
CONFIG_VERSION_VARIABLE=y
CONFIG_NET_RANDOM_ETHADDR=y
CONFIG_CLK_R9A07G043U=y
CONFIG_SYS_I2C_RCAR_IIC=y
CONFIG_SUPPORT_EMMC_BOOT=y
CONFIG_TEE=y
CONFIG_OPTEE=y
```

## configs/rzv2n-solidrun_defconfig
```kconfig
CONFIG_ARM=y
CONFIG_ARCH_CPU_INIT=y
CONFIG_ARCH_RENESAS=y
CONFIG_TEXT_BASE=0x50000000
CONFIG_SYS_MALLOC_LEN=0x4000000
CONFIG_ENV_SIZE=0x20000
CONFIG_ENV_OFFSET=0x001E0000
CONFIG_ENV_SECT_SIZE=0x20000
CONFIG_DEFAULT_DEVICE_TREE="rzv2n-hummingboard-iiot"
CONFIG_RCAR_GEN3=y
CONFIG_R9A09G056=y
CONFIG_TARGET_RZV2N_SOLIDRUN=y
# CONFIG_SPL is not set
CONFIG_SYS_LOAD_ADDR=0x58000000
CONFIG_PCI=y
CONFIG_FIT=y
CONFIG_DISTRO_DEFAULTS=y
CONFIG_USE_BOOTARGS=y
CONFIG_BOOTARGS="rw rootwait root=/dev/mmcblk1p2"
CONFIG_DEFAULT_FDT_FILE="renesas/r9a09g056n48-hummingboard-iiot.dtb"
CONFIG_LOGLEVEL=7
CONFIG_ID_EEPROM=y
CONFIG_CMD_BOOTZ=y
CONFIG_CMD_ERASEENV=y
CONFIG_CMD_GPIO=y
CONFIG_CMD_I2C=y
CONFIG_CMD_MMC=y
CONFIG_CMD_PCI=y
CONFIG_CMD_SPI=y
CONFIG_CMD_USB=y
CONFIG_CMD_USB_MASS_STORAGE=y
CONFIG_CMD_EXT4_WRITE=y
# CONFIG_OF_UPSTREAM is not set
CONFIG_ENV_OVERWRITE=y
CONFIG_ENV_IS_IN_SPI_FLASH=y
CONFIG_SYS_RELOC_GD_ENV_ADDR=y
CONFIG_VERSION_VARIABLE=y
CONFIG_NET_RANDOM_ETHADDR=y
CONFIG_REGMAP=y
CONFIG_SYSCON=y
CONFIG_RCAR_GPIO=y
CONFIG_RZV2N_GPIO=y
CONFIG_DM_PCA953X=y
CONFIG_SYS_I2C_RCAR_IIC=y
CONFIG_MTD=y
CONFIG_DM_SPI_FLASH=y
CONFIG_SPI_FLASH_BAR=y
CONFIG_SPI_FLASH_ISSI=y
CONFIG_SPI_FLASH_STMICRO=y
CONFIG_SPI_FLASH_WINBOND=y
CONFIG_PHY_MICREL=y
CONFIG_PHY_MICREL_KSZ90X1=y
CONFIG_DM_ETH_PHY=y
CONFIG_DWC_ETH_QOS=y
CONFIG_DWC_ETH_QOS_RZV2N=y
CONFIG_PCI_RCAR_GEN3=y
CONFIG_PINCTRL_PFC_RZV2N=y
CONFIG_DM_REGULATOR_FIXED=y
CONFIG_DM_REGULATOR_GPIO=y
CONFIG_SPI=y
CONFIG_DM_SPI=y
CONFIG_RENESAS_RPC_SPI=y
CONFIG_TEE=y
CONFIG_OPTEE=y
CONFIG_USB_XHCI_HCD=y
CONFIG_USB_GADGET_DOWNLOAD=y
```

## configs/t81_defconfig
```kconfig
CONFIG_ARM=y
CONFIG_THUNDERX_COMMON=y
#CONFIG_SYS_SOC="thunderx"
CONFIG_ARCH_THUNDERX=y
CONFIG_TARGET_THUNDERX_81XX=y
CONFIG_DM_I2C=y
CONFIG_DM_GPIO=y
CONFIG_DEFAULT_DEVICE_TREE="thunder-81xx"
CONFIG_SYS_EXTRA_OPTIONS="ARM64"
CONFIG_HUSH_PARSER=y
CONFIG_SYS_PROMPT="ThunderX_81XX> "
CONFIG_CMD_MEMTEST=y
CONFIG_CMD_MX_CYCLIC=y
# CONFIG_CMD_FLASH is not set
CONFIG_CMD_I2C=y
CONFIG_CMD_USB=y
# CONFIG_CMD_FPGA is not set
CONFIG_CMD_GPIO=y
CONFIG_CMD_TFTPPUT=y
CONFIG_CMD_TFTPSRV=y
CONFIG_CMD_RARP=y
CONFIG_CMD_DHCP=y
CONFIG_CMD_PING=y
CONFIG_CMD_CDP=y
CONFIG_CMD_SNTP=y
CONFIG_CMD_DNS=y
CONFIG_CMD_LINK_LOCAL=y
CONFIG_NET_RANDOM_ETHADDR=y
CONFIG_DM_I2C_COMPAT=y
CONFIG_MISC=y
CONFIG_PHYLIB=y
CONFIG_NETDEVICES=y
CONFIG_PCI=y
CONFIG_PCI_PNP=y
CONFIG_PCI_THUNDERX_ECAM=y
CONFIG_DEBUG_UART=y
CONFIG_DEBUG_UART_PL011=y
CONFIG_DEBUG_UART_BASE=0x87e028000000
CONFIG_DEBUG_UART_CLOCK=24000000
CONFIG_DEBUG_UART_SKIP_INIT=y
CONFIG_USB=y
CONFIG_DM_USB=y
CONFIG_USB_XHCI_HCD=y
CONFIG_USB_STORAGE=y
CONFIG_SYS_CONFIG_NAME="thunder_81xx"
CONFIG_DM_RTC=y
CONFIG_SHA1=y
CONFIG_SHA256=y
CONFIG_ERRNO_STR=y
CONFIG_SYS_I2C_THUNDERX_SLAVE_ADDR=0x77
CONFIG_ENV_VARS_UBOOT_CONFIG=y
CONFIG_OF_LIBFDT=y
```
