// SPDX-License-Identifier: (GPL-2.0+ OR MIT)
/*
 * Copyright 2025 Josua Mayer <josua@solid-run.com>
 */

#include "imx8mp-sr-som-u-boot.dtsi"
#include "imx8mp-hummingboard-pulse-common-u-boot.dtsi"
#include "imx8mp-hummingboard-pulse-mini-hdmi-u-boot.dtsi"
