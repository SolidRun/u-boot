// SPDX-License-Identifier: GPL-2.0
/*
 * Device Tree Source for the SolidRun G2L SoM
 *
 * Copyright (C) 2024 SolidRun Ltd.
 */

/dts-v1/;
#include "r9a07g044l.dtsi"
#include "r9a07g044l-u-boot.dtsi"
#include "rz_2l-sr-som.dtsi"

/ {
	model = "sr-rzg2l";
	compatible = "renesas,r9a07g044l", "renesas,rzg2l";

	memory@48000000 {
		device_type = "memory";
		/* first 128MB is reserved for secure area. */
		reg = <0 0x48000000 0 0x38000000>;
	};

};
