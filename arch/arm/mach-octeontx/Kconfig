## arch/arm/mach-octeontx/Kconfig
```kconfig
if ARCH_OCTEONTX

config SYS_VENDOR
	string
	default	"Marvell"

config SYS_SOC
	string
	default "octeontx"

config SYS_BOARD
	string
	default "octeontx"

config SYS_PCI_64BIT
	bool
	default y

endif
```

## arch/arm/mach-octeontx2/Kconfig
```kconfig
if ARCH_OCTEONTX2

config SYS_VENDOR
	string
	default	"Marvell"

config SYS_SOC
	string
	default "octeontx2"

config SYS_BOARD
	string
	default "octeontx2"

config SYS_PCI_64BIT
	bool
	default y

endif
```

## board/Marvell/octeontx/Kconfig
```kconfig
if ARCH_OCTEONTX

choice
	prompt "Target board"

config	TARGET_OCTEONTX_83XX
	bool "OcteonTX CN83XX"

config	TARGET_OCTEONTX_81XX
	bool "OcteonTX CN81XX"

endchoice

config SYS_CONFIG_NAME
	default "octeontx_81xx" if TARGET_OCTEONTX_81XX
	default "octeontx_83xx" if TARGET_OCTEONTX_83XX

endif
```

## board/renesas/rzv2n-dev/Kconfig
```kconfig
if TARGET_RZV2N_DEV

config SYS_SOC
	default "rmobile"

config SYS_BOARD
	default "rzv2n-dev"

config SYS_VENDOR
	default "renesas"

config SYS_CONFIG_NAME
	default "rzv2n-dev"

endif

if TARGET_RZV2N_EVK

config SYS_SOC
	default "rmobile"

config SYS_BOARD
	default "rzv2n-dev"

config SYS_VENDOR
	default "renesas"

config SYS_CONFIG_NAME
	default "rzv2n-evk"

endif
```

## configs/rzv2n-evk_defconfig
```kconfig
CONFIG_USB_GADGET=y
CONFIG_USB_RENESAS_USBHS=y
CONFIG_USB_GADGET_DOWNLOAD=y
CONFIG_USB_FUNCTION_MASS_STORAGE=y
CONFIG_CMD_USB_MASS_STORAGE=y
CONFIG_ARM=y
CONFIG_ARCH_CPU_INIT=y
CONFIG_ARCH_RMOBILE=y
CONFIG_SYS_TEXT_BASE=0x50000000
CONFIG_ENV_SIZE=0x20000
CONFIG_ENV_OFFSET=0x001E0000
CONFIG_DM_GPIO=y
CONFIG_RCAR_GEN3=y
CONFIG_R9A09G056=y
CONFIG_TARGET_RZV2N_EVK=y
CONFIG_DEFAULT_DEVICE_TREE="rzv2n-evk"
CONFIG_SMBIOS_PRODUCT_NAME=""
CONFIG_SPL=n
CONFIG_FIT=y
CONFIG_SUPPORT_RAW_INITRD=y
CONFIG_DEFAULT_FDT_FILE="rzv2n-evk.dtb"
CONFIG_VERSION_VARIABLE=y
CONFIG_HUSH_PARSER=y
CONFIG_CMD_BOOTZ=y
CONFIG_CMD_GPIO=y
CONFIG_CMD_I2C=y
CONFIG_CMD_MMC=y
CONFIG_CMD_PCI=y
CONFIG_CMD_USB=y
CONFIG_CMD_DHCP=y
CONFIG_CMD_MII=y
CONFIG_CMD_PING=y
CONFIG_CMD_EXT2=y
CONFIG_CMD_EXT4=y
CONFIG_CMD_EXT4_WRITE=y
CONFIG_CMD_FAT=y
CONFIG_CMD_FS_GENERIC=y
CONFIG_OF_CONTROL=y
CONFIG_OF_PLATDATA=y
CONFIG_OF_LIST="rzv2n-evk"
CONFIG_MULTI_DTB_FIT_LZO=y
CONFIG_MULTI_DTB_FIT_USER_DEFINED_AREA=y
CONFIG_ENV_OVERWRITE=y
CONFIG_SYS_RELOC_GD_ENV_ADDR=y
CONFIG_REGMAP=y
CONFIG_SYSCON=y
CONFIG_CLK=y
#CONFIG_CLK_RENESAS=y
#CONFIG_CLK_R9A09G056=y
CONFIG_RCAR_GPIO=y
#CONFIG_PINCTRL_PFC_RZG2L=y
CONFIG_PINCTRL_PFC_RZV2N=y
CONFIG_RZV2N_GPIO=y
CONFIG_DM_I2C=y
CONFIG_SYS_I2C_RCAR_IIC=y
CONFIG_SH_SDHI=y
CONFIG_BITBANGMII=y
CONFIG_PHY_MICREL=y
CONFIG_PHY_MICREL_KSZ90X1=y
CONFIG_DM_ETH=y
CONFIG_DM_ETH_PHY=y
CONFIG_DWC_ETH_QOS=y
CONFIG_DWC_ETH_QOS_RZV2N=y
CONFIG_RENESAS_RAVB=y
CONFIG_PCI=y
CONFIG_DM_PCI=y
CONFIG_PCI_RCAR_GEN3=y
CONFIG_DM_REGULATOR=y
CONFIG_DM_REGULATOR_FIXED=y
CONFIG_DM_REGULATOR_GPIO=y
CONFIG_SCIF_CONSOLE=y
CONFIG_TEE=y
CONFIG_OPTEE=y
CONFIG_USB=y
CONFIG_DM_USB=y
CONFIG_USB_XHCI_HCD=y
CONFIG_USB_EHCI_HCD=y
CONFIG_USB_EHCI_GENERIC=y
CONFIG_USB_STORAGE=y
CONFIG_OF_LIBFDT_OVERLAY=y
CONFIG_SMBIOS_MANUFACTURER=""
CONFIG_ENV_IS_IN_SPI_FLASH=y
CONFIG_SYS_I2C_RZG2L_RIIC=y
CONFIG_SPI_FLASH=y
CONFIG_SPI_FLASH_BAR=y
CONFIG_SPI_FLASH_USE_4K_SECTORS=y
CONFIG_SPI=y
CONFIG_DM_SPI=y
CONFIG_SPI_FLASH_WINBOND=y
CONFIG_RENESAS_RPC_SPI=y
CONFIG_CMD_SF=y
CONFIG_CMD_SPI=y
CONFIG_SPI_FLASH_STMICRO=y
CONFIG_DM_SPI_FLASH=y
CONFIG_ENV_SECT_SIZE=0x20000
```
