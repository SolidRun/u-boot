## configs/t83_defconfig
```kconfig
CONFIG_ARM=y
# CONFIG_ARM64_SUPPORT_AARCH32 is not set
CONFIG_ARCH_THUNDERX=y
CONFIG_DEFAULT_DEVICE_TREE="thunder-83xx"
CONFIG_DEBUG_UART=y
CONFIG_FIT=y
CONFIG_FIT_SIGNATURE=y
CONFIG_SYS_EXTRA_OPTIONS="ARM64"
CONFIG_BOOTDELAY=5
# CONFIG_DISPLAY_CPUINFO is not set
CONFIG_HUSH_PARSER=y
CONFIG_CMD_MEMTEST=y
CONFIG_CMD_MX_CYCLIC=y
# CONFIG_CMD_FLASH is not set
CONFIG_CMD_MMC=y
CONFIG_CMD_PART=y
CONFIG_CMD_SF=y
CONFIG_CMD_I2C=y
CONFIG_CMD_USB=y
# CONFIG_CMD_FPGA is not set
CONFIG_CMD_GPIO=y
CONFIG_CMD_TFTPPUT=y
CONFIG_CMD_TFTPSRV=y
CONFIG_CMD_RARP=y
CONFIG_CMD_DHCP=y
CONFIG_CMD_PING=y
CONFIG_CMD_CDP=y
CONFIG_CMD_SNTP=y
CONFIG_CMD_DNS=y
CONFIG_CMD_LINK_LOCAL=y
CONFIG_CMD_EXT4=y
CONFIG_CMD_EXT4_WRITE=y
CONFIG_CMD_FAT=y
CONFIG_ISO_PARTITION=y
CONFIG_EFI_PARTITION=y
CONFIG_PARTITION_TYPE_GUID=y
CONFIG_OF_BOARD=y
CONFIG_NET_RANDOM_ETHADDR=y
CONFIG_MISC=y
CONFIG_PHYLIB=y
CONFIG_PHYLIB_10G=y
CONFIG_PHY_AQUANTIA=y
CONFIG_PHY_BROADCOM=y
CONFIG_PHY_MARVELL=y
CONFIG_PHY_MICREL=y
CONFIG_PHY_MICREL_KSZ9021=y
CONFIG_PHY_MICREL_KSZ9031=y
CONFIG_PHY_MSCC=y
CONFIG_PHY_REALTEK=y
CONFIG_PHY_VITESSE=y
CONFIG_NETDEVICES=y
CONFIG_DM_RTC=y
CONFIG_DEBUG_UART_PL011=y
CONFIG_DEBUG_UART_BASE=0x87e028000000
CONFIG_DEBUG_UART_CLOCK=24000000
CONFIG_DEBUG_UART_SKIP_INIT=y
CONFIG_DM_SPI=y
CONFIG_CAVIUM_SPI=y
CONFIG_USB=y
CONFIG_DM_USB=y
CONFIG_USB_XHCI_HCD=y
CONFIG_USB_STORAGE=y
CONFIG_ERRNO_STR=y
```

## configs/thunderx_81xx_defconfig
```kconfig
CONFIG_ARM=y
CONFIG_TARGET_THUNDERX_81XX=y
CONFIG_DM_I2C=y
CONFIG_DM_GPIO=y
CONFIG_DEFAULT_DEVICE_TREE="thunder-81xx"
CONFIG_SYS_EXTRA_OPTIONS="ARM64"
CONFIG_HUSH_PARSER=y
CONFIG_SYS_PROMPT="ThunderX_81XX> "
CONFIG_CMD_MEMTEST=y
CONFIG_CMD_MX_CYCLIC=y
# CONFIG_CMD_FLASH is not set
CONFIG_CMD_I2C=y
CONFIG_CMD_USB=y
# CONFIG_CMD_FPGA is not set
CONFIG_CMD_GPIO=y
CONFIG_CMD_TFTPPUT=y
CONFIG_CMD_TFTPSRV=y
CONFIG_CMD_RARP=y
CONFIG_CMD_DHCP=y
CONFIG_CMD_PING=y
CONFIG_CMD_CDP=y
CONFIG_CMD_SNTP=y
CONFIG_CMD_DNS=y
CONFIG_CMD_LINK_LOCAL=y
CONFIG_NET_RANDOM_ETHADDR=y
CONFIG_DM_I2C_COMPAT=y
CONFIG_MISC=y
CONFIG_PHYLIB=y
CONFIG_NETDEVICES=y
CONFIG_PCI_THUNDERX_ECAM=y
CONFIG_DEBUG_UART=y
CONFIG_DEBUG_UART_PL011=y
CONFIG_DEBUG_UART_BASE=0x87e028000000
CONFIG_DEBUG_UART_CLOCK=24000000
CONFIG_DEBUG_UART_SKIP_INIT=y
CONFIG_USB=y
CONFIG_DM_USB=y
CONFIG_USB_XHCI_HCD=y
CONFIG_USB_STORAGE=y
```

## configs/thunderx_88xx_defconfig
```kconfig
CONFIG_ARM=y
CONFIG_TARGET_THUNDERX_88XX=y
CONFIG_SYS_TEXT_BASE=0x00500000
CONFIG_NR_DRAM_BANKS=1
CONFIG_DEBUG_UART_BASE=0x87e024000000
CONFIG_DEBUG_UART_CLOCK=24000000
CONFIG_IDENT_STRING=" for Cavium Thunder CN88XX ARM v8 Multi-Core"
CONFIG_DEBUG_UART=y
CONFIG_BOOTDELAY=5
CONFIG_USE_BOOTARGS=y
CONFIG_BOOTARGS="console=ttyAMA0,115200n8 earlycon=pl011,0x87e024000000 debug maxcpus=48 rootwait rw root=/dev/sda2 coherent_pool=16M"
# CONFIG_DISPLAY_CPUINFO is not set
# CONFIG_DISPLAY_BOARDINFO is not set
CONFIG_DEFAULT_DEVICE_TREE="thunder-88xx"
CONFIG_SYS_EXTRA_OPTIONS="ARM64"
CONFIG_HUSH_PARSER=y
# CONFIG_AUTO_COMPLETE is not set
CONFIG_SYS_PROMPT="ThunderX_88XX> "
# CONFIG_CMD_EXPORTENV is not set
# CONFIG_CMD_IMPORTENV is not set
# CONFIG_CMD_EDITENV is not set
# CONFIG_CMD_SAVEENV is not set
# CONFIG_CMD_ENV_EXISTS is not set
# CONFIG_CMD_FLASH is not set
# CONFIG_CMD_NET is not set
CONFIG_DEFAULT_DEVICE_TREE="thunderx-88xx"
# CONFIG_CMD_NFS is not set
CONFIG_CMD_MEMTEST=y
CONFIG_CMD_MX_CYCLIC=y
# CONFIG_CMD_FLASH is not set
CONFIG_CMD_I2C=y
CONFIG_CMD_USB=y
# CONFIG_CMD_FPGA is not set
CONFIG_CMD_TFTPPUT=y
CONFIG_CMD_TFTPSRV=y
CONFIG_CMD_RARP=y
CONFIG_CMD_DHCP=y
CONFIG_CMD_PING=y
CONFIG_CMD_CDP=y
CONFIG_CMD_SNTP=y
CONFIG_CMD_DNS=y
CONFIG_CMD_LINK_LOCAL=y
CONFIG_NET_RANDOM_ETHADDR=y
CONFIG_DM=y
# CONFIG_MMC is not set
CONFIG_DM_SERIAL=y
CONFIG_PCI_THUNDERX_ECAM=y
CONFIG_DEBUG_UART=y
CONFIG_DEBUG_UART_PL011=y
CONFIG_DEBUG_UART_SKIP_INIT=y
```

## doc/uImage.FIT/update_mv_flash.its
```
/*
 * Automatic software update for U-Boot and ATF with a single flash image
 * Make sure the flashing addresses ('load' prop) is correct for your board!
 */

/dts-v1/;

/ {
	description = "Automatic flash image update";
	#address-cells = <1>;

	images {
		update-1 {
			description = "U-Boot + ATF image";
			data = /incbin/("./flash-image.bin");
			compression = "none";
			type = "firmware";
			load = <00000000>;
			hash-1 {
				algo = "sha1";
			};
		};
	};
};
```

## drivers/net/cavium/Kconfig
```kconfig
config CAVIUM_NET
	bool "Cavium Ethernet support"
	depends on NET && ARCH_OCTEONTX
	help
	  You must select Y to enable cavium network device support

	  If unsure, say n

if CAVIUM_NET

config OCTEONTX_VNIC
	bool "Enable vNIC device support"
	depends on CAVIUM_NET
	help
	  Enables support for NIC controller

config OCTEONTX_BGX
	bool "Enable BGX device support"
	depends on CAVIUM_NET
	help
	  Enables support for LMAC layer

config OCTEONTX_XCV
	bool "Enable RGMII(XCV) device support"
	depends on CAVIUM_NET
	help
	  Enables support for RGMII

config OCTEONTX_SMI
	bool "Enable MDIO device support"
	depends on CAVIUM_NET
	help
	  Enables support for SMI/MDIO bus controller

endif

source drivers/net/cavium/octeontx2/Kconfig
```

## drivers/net/cavium/octeontx2/Kconfig
```kconfig
config CAVIUM_NET_OCTEONTX2
	bool "Cavium Ethernet support for OCTEONTX2 chips"
	depends on NET && ARCH_OCTEONTX2
	help
	  You must select Y to enable cavium network device support

	  If unsure, say n

if CAVIUM_NET_OCTEONTX2

config OCTEONTX2_CGX
	bool "Enable CGX device support"
	help
	  Enables support for LMAC layer

config OCTEONTX2_RVU
	bool "Enable RVU support"
	help
	  Enables support for Resource Virtualization Co-processor Unit

endif
```

## drivers/pci_endpoint/Kconfig
```kconfig
# SPDX-License-Identifier: GPL-2.0
#
# PCI Endpoint Support
#

menu "PCI Endpoint"

config PCI_ENDPOINT
	bool "PCI Endpoint Support"
	depends on DM
	help
	   Enable this configuration option to support configurable PCI
	   endpoints. This should be enabled if the platform has a PCI
	   controllers that can operate in endpoint mode (as a device
	   connected to PCI host or bridge).

config PCIE_CADENCE_EP
	bool "Cadence PCIe endpoint controller"
	depends on PCI_ENDPOINT
	help
	  Say Y here if you want to support the Cadence PCIe controller in
	  endpoint mode. This PCIe controller may be embedded into many
	  different vendors SoCs.

config PCI_SANDBOX_EP
	bool "Sandbox PCIe endpoint controller"
	depends on PCI_ENDPOINT
	help
	  Say Y here if you want to support the Sandbox PCIe controller in
	  endpoint mode.
	  The sandbox driver act as a dummy driver which stores and
	  retrieves PCIe endpoint configuration as is.

config PCIE_DW_MVEBU_EP
	bool "Enable Armada-8K/OcteonTX2 CN91xx PCIe endpoint driver"
	depends on PCI_ENDPOINT
	depends on ARMADA_8K
	help
	  Say Y here if you want to enable PCIe controller support in endpoint
	  mode on Marvell Armada-8K/OcteonTX2 CN91xx SoCs.
	  The PCIe controller on Armada-8K/OcteonTX2 CN91xx is based on
	  DesignWare hardware.

endmenu
```

## lib/tlv/Kconfig
```kconfig
config EEPROM_TLV_LIB
	bool "Enable EEPROM TLV library"
	depends on I2C_EEPROM
	select CRC32
	help
	  Selecting this option will enable the shared EEPROM TLV library code.
	  It provides functions for reading, writing and parsing of
	  TLV-encoded data from EEPROMs.

config SPL_EEPROM_TLV_LIB
	bool "Enable EEPROM TLV library for SPL"
	depends on SPL_I2C_EEPROM
	select SPL_CRC32
	select SPL_DRIVERS_MISC
	help
	  Selecting this option will enable the shared EEPROM TLV library code.
	  It provides functions for reading, writing and parsing of
	  TLV-encoded data from EEPROMs.
```
